#include <behaviors.dtsi>
#include <dt-bindings/zmk/bt.h>
#include <dt-bindings/zmk/keys.h>

#define NAV lt 1
#define NUM lt 2
#define KOR_COMBO layers = <0>;
#define EN_COMBO layers = <3>;

/ {
    behaviors {
        hm: homerow_mods {
            compatible = "zmk,behavior-hold-tap";
            #binding-cells = <2>;
            tapping-term-ms = <200>;
            quick-tap-ms = <200>;
            require-prior-idle-ms = <100>;
            flavor = "tap-preferred";
            bindings = <&kp>, <&kp>;
        };

        ht: hold_tap {
            compatible = "zmk,behavior-hold-tap";
            #binding-cells = <2>;
            tapping-term-ms = <200>;
            quick-tap-ms = <200>;
            require-prior-idle-ms = <100>;
            flavor = "tap-preferred";
            bindings = <&kp>, <&kp>;
        };

        td_lang: tap_dance_lang {
            compatible = "zmk,behavior-tap-dance";
            #binding-cells = <0>;
            tapping-term-ms = <200>;
            bindings = <&kp RALT>, <&kp CAPS>;
        };

        td_o: tap_dance_o {
            compatible = "zmk,behavior-tap-dance";
            #binding-cells = <0>;
            tapping-term-ms = <200>;
            bindings = <&kp O>, <&kp LS(O)>;
        };

        td_p: tap_dance_p {
            compatible = "zmk,behavior-tap-dance";
            #binding-cells = <0>;
            tapping-term-ms = <200>;
            bindings = <&kp P>, <&kp LS(P)>;
        };
    };

    combos {
        compatible = "zmk,combos";
        combo_esc { timeout-ms = <50>; key-positions = <0 1>; bindings = <&kp ESC>; };
        combo_1 { timeout-ms = <50>; key-positions = <0 18>; bindings = <&kp LS(Q)>; KOR_COMBO };
        combo_2 { timeout-ms = <50>; key-positions = <1 18>; bindings = <&kp LS(W)>; KOR_COMBO };
        combo_3 { timeout-ms = <50>; key-positions = <2 18>; bindings = <&kp LS(E)>; KOR_COMBO };
        combo_4 { timeout-ms = <50>; key-positions = <3 18>; bindings = <&kp LS(R)>; KOR_COMBO };
        combo_5 { timeout-ms = <50>; key-positions = <4 18>; bindings = <&kp LS(T)>; KOR_COMBO };
        combo_6 { timeout-ms = <50>; key-positions = <1 2>; bindings = <&td_p>; KOR_COMBO };
        combo_7 { timeout-ms = <50>; key-positions = <2 3>; bindings = <&td_o>; KOR_COMBO };
        combo_8 { timeout-ms = <50>; key-positions = <7 18>; bindings = <&kp G>; KOR_COMBO };
        combo_9 { timeout-ms = <50>; key-positions = <5 6>; bindings = <&kp Y>; KOR_COMBO };
        combo_10 { timeout-ms = <50>; key-positions = <6 7>; bindings = <&kp U>; KOR_COMBO };
        combo_11 { timeout-ms = <50>; key-positions = <7 8>; bindings = <&kp I>; KOR_COMBO };
        combo_12 { timeout-ms = <50>; key-positions = <8 9>; bindings = <&kp B>; KOR_COMBO };
        combo_13 { timeout-ms = <50>; key-positions = <10 11>; bindings = <&kp Z>; KOR_COMBO };
        combo_14 { timeout-ms = <50>; key-positions = <11 12>; bindings = <&kp X>; KOR_COMBO };
        combo_15 { timeout-ms = <50>; key-positions = <12 13>; bindings = <&kp C>; KOR_COMBO };
        combo_16 { timeout-ms = <50>; key-positions = <13 14>; bindings = <&kp V>; KOR_COMBO };
        combo_17 { timeout-ms = <50>; key-positions = <13 7>; bindings = <&kp N>; KOR_COMBO };

        combo_20 { timeout-ms = <50>; key-positions = <0 18>; bindings = <&kp J>; EN_COMBO };
        combo_21 { timeout-ms = <50>; key-positions = <1 18>; bindings = <&kp M>; EN_COMBO };
        combo_22 { timeout-ms = <50>; key-positions = <2 18>; bindings = <&kp B>; EN_COMBO };
        combo_23 { timeout-ms = <50>; key-positions = <5 18>; bindings = <&kp V>; EN_COMBO };
        combo_24 { timeout-ms = <50>; key-positions = <6 18>; bindings = <&kp C>; EN_COMBO };
        combo_25 { timeout-ms = <50>; key-positions = <7 18>; bindings = <&kp L>; EN_COMBO };
        combo_26 { timeout-ms = <50>; key-positions = <8 18>; bindings = <&kp Z>; EN_COMBO };
        combo_27 { timeout-ms = <50>; key-positions = <9 18>; bindings = <&kp Q>; EN_COMBO };
        combo_28 { timeout-ms = <50>; key-positions = <10 18>; bindings = <&kp X>; EN_COMBO };
        combo_29 { timeout-ms = <50>; key-positions = <11 18>; bindings = <&kp G>; EN_COMBO };
        combo_30 { timeout-ms = <50>; key-positions = <12 18>; bindings = <&kp K>; EN_COMBO };
    };

      keymap {
        compatible = "zmk,keymap";

        default_layer {
            bindings = <
            &ht F1 Q      &ht F2 W      &ht F3 E      &ht F4 R      &ht F5 T
            &hm LGUI A    &hm LALT S    &hm LCTRL D   &hm LSHFT F   &ht G L
            &ht Z H       &ht X J       &ht C K       &ht V M       &kp N
                          &tog(3)       &tog(0)       &NUM ENTER    &NAV SPACE
            >;
        };

        1_layer {
            bindings = <
            &kp HOME    &kp END     &kp UP      &kp BSPC    &kp DEL
            &kp TAB     &kp LEFT    &kp DOWN    &kp RIGHT   &kp PG_UP
            &kp Z       &kp X       &kp C       &kp V       &kp PG_DN
                        &trans      &trans      &trans      &trans
            >;
        };

        2_layer {
            bindings = <
            &kp EQUAL   &kp N7      &kp N8      &kp N9      &kp BSPC
            &kp MINUS   &kp N4      &kp N5      &kp N6      &kp PLUS
            &kp N0      &kp N1      &kp N2      &kp N3      &kp DOT
                        &trans      &trans      &trans      &trans
            >;
        };

        en1_layer {
            bindings = <
            &kp P       &kp W       &kp R       &kp A       &kp F
            &kp D       &kp T       &kp H       &kp E       &kp O
            &kp Y       &kp S       &kp N       &kp I       &kp U
                        &trans      &trans      &NUM ENTER  &lt 4 SPACE
            >;
        };

        en2_layer {
            bindings = <
            &kp J       &kp M       &kp B       &trans      &trans
            &kp V       &kp C       &kp L       &kp Z       &kp Q
            &kp X       &kp G       &kp K       &trans      &trans
                        &trans      &trans      &trans      &trans
            >;
        };
    };
};
