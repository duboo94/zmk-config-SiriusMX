## boards/shields/sirius/Kconfig.defconfig
```kconfig
if SHIELD_SIRIUS_LEFT

config ZMK_KEYBOARD_NAME
    default "SIRIUS MX"

config ZMK_SPLIT_ROLE_CENTRAL
    default y

endif

if SHIELD_SIRIUS_LEFT || SHIELD_SIRIUS_RIGHT

config ZMK_SPLIT
    default y

endif
```
